## boards/shields/handwire27/Kconfig.defconfig
```kconfig
# Copyright (c) 2020 Pete Johanson, Kurtis Lew
# SPDX-License-Identifier: MIT

if SHIELD_HANDWIRE27_LEFT

config ZMK_KEYBOARD_NAME
    default "Handwire27"

config ZMK_SPLIT_ROLE_CENTRAL
    default y

endif

if SHIELD_HANDWIRE27_LEFT || SHIELD_HANDWIRE27_RIGHT

config ZMK_SPLIT
    default y

endif
```

## boards/shields/handwire27/Kconfig.shield
```kconfig
# Copyright (c) 2020 Pete Johanson, Kurtis Lew
# SPDX-License-Identifier: MIT

config SHIELD_HANDWIRE27_LEFT
    def_bool $(shields_list_contains,handwire27_left)

config SHIELD_HANDWIRE27_RIGHT
    def_bool $(shields_list_contains,handwire27_right)
```

## boards/shields/osito/Kconfig.defconfig
```kconfig
# SPDX-License-Identifier: MIT

if SHIELD_OSITO_LEFT

config ZMK_KEYBOARD_NAME
    default "Osito"

config ZMK_SPLIT_ROLE_CENTRAL
    default y

endif

if SHIELD_OSITO_LEFT || SHIELD_OSITO_RIGHT

config ZMK_SPLIT
    default y

endif
```

## boards/shields/osito/Kconfig.shield
```kconfig
# SPDX-License-Identifier: MIT

config SHIELD_OSITO_LEFT
    def_bool $(shields_list_contains,osito_left)

config SHIELD_OSITO_RIGHT
    def_bool $(shields_list_contains,osito_right)
```

## boards/shields/palomita/Kconfig.defconfig
```kconfig
# SPDX-License-Identifier: MIT

if SHIELD_PALOMITA_LEFT

config ZMK_KEYBOARD_NAME
    default "Palomita"

config ZMK_SPLIT_ROLE_CENTRAL
    default y

endif

if SHIELD_PALOMITA_LEFT || SHIELD_PALOMITA_RIGHT

config ZMK_SPLIT
    default y

endif
```

## boards/shields/palomita/Kconfig.shield
```kconfig
# SPDX-License-Identifier: MIT

config SHIELD_PALOMITA_LEFT
    def_bool $(shields_list_contains,palomita_left)

config SHIELD_PALOMITA_RIGHT
    def_bool $(shields_list_contains,palomita_right)
```
